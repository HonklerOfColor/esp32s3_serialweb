## sdkconfig.defaults
```kconfig
CONFIG_IDF_TARGET="esp32s3"
CONFIG_ESP_WIFI_STA_SUPPORT=y
CONFIG_ESP_HTTP_SERVER_ENABLE=y
CONFIG_HTTPD_WS_SUPPORT=y
CONFIG_HTTPD_WS_POST_HANDSHAKE_CB_SUPPORT=y

# Native USB-C OTG Host (Cisco Console direkt am ESP-USB-C)
CONFIG_USB_OTG_SUPPORTED=y
CONFIG_USB_HOST_CONTROL_TRANSFER_MAX_SIZE=4096
CONFIG_USB_HOST_HW_BUFFER_BIAS_BALANCED=y

# XIAO ESP32-S3: Boot-Log kurz über USB-Serial/JTAG, danach USB-C = OTG-Host
CONFIG_ESP_CONSOLE_UART_DEFAULT=y
CONFIG_ESP_CONSOLE_SECONDARY_USB_SERIAL_JTAG=y

# W5500 SPI-Ethernet (Treiber kommt via espressif/w5500 Component)
CONFIG_ETH_USE_SPI_ETHERNET=y

# NVS
CONFIG_NVS_FLASH=y

# Benutzerdefinierte Partitionstabelle (2 MB App für WireGuard + OTG)
# Das XIAO ESP32-S3 hat 8 MB Flash (Boot-Log: "Detected size(8192k)")
CONFIG_ESPTOOLPY_FLASHSIZE_8MB=y
CONFIG_ESPTOOLPY_FLASHSIZE="8MB"
CONFIG_PARTITION_TABLE_CUSTOM=y
CONFIG_PARTITION_TABLE_CUSTOM_FILENAME="partitions.csv"

# IDF 6.0 WireGuard-Fix: aktiviert LWIP_ESP_NETIF_DATA=1 damit lwip_get_esp_netif()
# netif_client_data statt netif->state nutzt. Verhindert Crash wenn WireGuard-netif
# bei lwIP-Callbacks fälschlicherweise als esp_netif_t* interpretiert wird.
CONFIG_ESP_NETIF_BRIDGE_EN=y

# Debug: verbose logging
CONFIG_LOG_DEFAULT_LEVEL_DEBUG=y
CONFIG_LOG_MAXIMUM_LEVEL_DEBUG=y
```
